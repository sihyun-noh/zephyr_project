## boards/arm/seedfic_lora_datalogger/Kconfig.board
```kconfig
# SeedFic LoRa DataLogger board configuration

# Copyright (c) 2023 SEEDFIC Inc.
# SPDX-License-Identifier: Apache-2.0

config BOARD_SEEDFIC_LORA_DATALOGGER
	bool "SeedFic LoRa DataLogger"
	depends on SOC_STM32WLE5XX
```

## boards/arm/seedfic_lora_rak3172/Kconfig.board
```kconfig
# SeedFic LoRa DataLogger board configuration

# Copyright (c) 2023 SEEDFIC Inc.
# SPDX-License-Identifier: Apache-2.0

config BOARD_SEEDFIC_LORA_IRRIGRATION
	bool "SeedFic LoRa Irrigation"
	depends on SOC_STM32WLE5XX
```

## boards/arm/seedfic_lora_rak3172/Kconfig.defconfig
```kconfig
# SeedFic LoRa DataLogger board configuration

# Copyright (c) 2023 SEEDFIC Inc.
# SPDX-License-Identifier: Apache-2.0

if BOARD_SEEDFIC_LORA_IRRIGRATION

config BOARD
	default "seedfic_lora_irrigration"

endif # BOARD_SEEDFIC_LORA_DATALOGGER
```

## dts/bindings/gpio-relays.yaml
```yaml
# Copyright (c) 2018, Linaro Limited
# SPDX-License-Identifier: Apache-2.0

description: |
  This allows you to define a group of relays. Each relay in the group is
  controlled by a GPIO. Each relay is defined in a child node of the
  gpio-relay node.

  Here is an example which defines a relay in the node /relays:

  / {
  	relays {
  		compatible = "gpio-relays";
  		realy_0 {
  			gpios = <&gpio0 1 GPIO_ACTIVE_LOW>;
  		};
  	};
  };

compatible: "gpio-relays"

child-binding:
  description: GPIO relay child node
  properties:
    gpios:
      type: phandle-array
      required: true
    label:
      type: string
      description: |
        Human readable string describing the relay. It can be used by an
        application to identify this relay or to retrieve its number/index
        (i.e. child node number) on the parent device.
```

## lib/framework/Kconfig
```kconfig
menuconfig FRAMEWORK
  bool "SEED system event and message framework"
  help
     Inter-task communication using messages and events

if FRAMEWORK

choice
  prompt "System Framework Assertion"
  optional
    help
      The default is disabled.

  config SYS_ASSRET_ENABLED
    bool "Enable Framework assertion"

  config SYS_ASSERT_ENABLED_USE_ZEPHYR
    bool "Framework assertion maps to Zephyr assertion"
    help
      The framework assertion is enabled if
      Zephyr assertions are enabled.

endchoice

if SYS_ASSERT_ENABLED || SYS_ASSERT_ENABLED_USE_ZEPHYR

config SYS_DEBUG
  bool "Enable System Framework Debug (and debug assertions)"

config SYS_ASSERT_ON_BROADCAST_FROM_ISR
  bool "Assert when a broadcast msg occurs in ISR context"
  default y
  help
     Broadcast can be time consuming on some processors.

endif # SYS_ASSERT_ENABLED || SYS_ASSERT_ENABLED_USE_ZEPHYR

config SYS_MAX_MSG_RECEIVES
  int "The maximum number of messages receivers"
  default 4

config BUFFER_POOL_SIZE
  int "Zephyr heap used by the system framework"
  default 1024

config BUFFER_POOL_STATS
	bool "Enable buffer pool statistics"

config BUFFER_POOL_WINDOW_SIZE
	int "Number of entries in stats of recently used sizes"
	depends on BUFFER_POOL_STATS
	default 0
	help
	  Requires 2 bytes per entry

config BUFFER_POOL_CHECK_DOUBLE_FREE
	bool "Print error if duplicate free is detected"
	help
	  Requires 4 bytes per allocation.

config BUFFER_POOL_SHELL
	bool "Enable Buffer Pool Shell"
	select BUFFER_POOL_STATS

endif #FRAMEWORK
```
